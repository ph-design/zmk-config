## boards/phdesign/ph_lite/Kconfig.defconfig
```kconfig
# Copyright (c) 2025 Team PHDesign
# SPDX-License-Identifier: MIT

if BOARD_PH_LITE

if USB_DEVICE_STACK

config USB_NRFX
    default y

config USB_DEVICE_VID
    default 0x5048

config USB_DEVICE_PID
    default 0xFF00

config USB_DEVICE_MANUFACTURER
    default "Team PHDesign"

endif # USB_DEVICE_STACK

config BT_CTLR
    default BT

endif # BOARD_PH_LITE
```

## boards/phdesign/ph_lite/Kconfig.ph_lite
```kconfig
# Copyright (c) 2025 Team PHDesign
# SPDX-License-Identifier: Apache-2.0

config BOARD_PH_LITE
	select SOC_NRF52840_QIAA
```

## boards/shields/PH60-Multi_V2/Kconfig.defconfig
```kconfig
if SHIELD_PH60_MULTI_V2

config ZMK_KEYBOARD_NAME
    default "PH60-Multi_V2"

endif
```

## boards/shields/PH60-Multi_V2/Kconfig.shield
```kconfig
# Copyright (c) 2025 Team PHDesign
# SPDX-License-Identifier: MIT

config SHIELD_PH60_MULTI_V2
	def_bool $(shields_list_contains,PH60-Multi_V2)
```

## boards/shields/PH60-SC_V2/Kconfig.shield
```kconfig
# Copyright (c) 2025 Team PHDesign
# SPDX-License-Identifier: MIT

config SHIELD_PH60_SC_V2
	def_bool $(shields_list_contains,PH60-SC_V2)
```
